## block/Kconfig.iosched.rej
```kconfig
--- block/Kconfig.iosched
+++ block/Kconfig.iosched
@@ -136,6 +136,19 @@
 	config DEFAULT_DEADLINE
 		bool "Deadline" if IOSCHED_DEADLINE=y
 
+config IOSCHED_SIOPLUS
+       tristate "Simple I/O scheduler plus"
+       default y
+       ---help---
+         The Simple I/O scheduler is an extremely simple scheduler,
+         based on noop and deadline, that relies on deadlines to
+         ensure fairness. The algorithm does not do any sorting but
+         basic merging, trying to keep a minimum overhead. It is aimed
+         mainly for aleatory access devices (eg: flash devices).
+
+
+
+
     config DEFAULT_ROW
         bool "ROW" if IOSCHED_ROW=y
         help
@@ -161,6 +174,9 @@
     config DEFAULT_SIO
         bool "SIO" if IOSCHED_SIO=y
 
+	config DEFAULT_SIOPLUS
+		bool "SIOPLUS" if IOSCHED_SIOPLUS=y
+
     config DEFAULT_FIFO
         bool "FIFO" if IOSCHED_FIFO=y
 
@@ -176,6 +192,7 @@
 	default "cfq" if DEFAULT_CFQ
     	default "bfq" if DEFAULT_BFQ
 	default "noop" if DEFAULT_NOOP
+	default "sioplus" if DEFAULT_SIOPLUS
         default "zen" if DEFAULT_ZEN
     	default "sio" if DEFAULT_SIO
     	default "vr" if DEFAULT_VR
```

## drivers/staging/android/Kconfig.rej
```kconfig
--- drivers/staging/android/Kconfig
+++ drivers/staging/android/Kconfig
@@ -67,6 +67,15 @@
 	---help---
 	  Register processes to be killed when memory is low
 
+config ANDROID_LOW_MEMORY_KILLER_AUTODETECT_OOM_ADJ_VALUES
+	bool "Android Low Memory Killer: detect oom_adj values"
+	depends on ANDROID_LOW_MEMORY_KILLER
+	default y
+	---help---
+	  Detect oom_adj values written to
+	  /sys/module/lowmemorykiller/parameters/adj and convert them
+	  to oom_score_adj values.
+
 source "drivers/staging/android/switch/Kconfig"
 
 config ANDROID_INTF_ALARM_DEV
```
